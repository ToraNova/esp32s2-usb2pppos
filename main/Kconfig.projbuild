## main/Kconfig.projbuild
```kconfig
menu "Example Configuration"

    config EXAMPLE_MANUAL_DESC
        bool "Set up a USB descriptor manually in code"
        default y
        help
            You can set up a descriptor using Menuconfig or independently of
            your project configuration - manually in code

    config CFG_TUSB_NET
	bool "Enable CFG_TUSB_NET"
	default y
	help
	    Enable the RNDIS/USB_CDC_ECM module on tinyusb's stack

    config EXAMPLE_ETH_PHY_RST_GPIO
        int "PHY Reset GPIO number"
        default 16 if IDF_TARGET_ESP32
        default 5 if IDF_TARGET_ESP32S2 || IDF_TARGET_ESP32C3
        help
            Set the GPIO number used to reset PHY chip.
            Set to -1 to disable PHY chip hardware reset.

    config EXAMPLE_ETH_PHY_ADDR
        int "PHY Address"
        range 0 31
        default 1
        help
            Set PHY address according your board schematic.
endmenu
```

## sdkconfig.defaults
```kconfig
CONFIG_ESP_MAIN_TASK_STACK_SIZE=8192

CONFIG_TINYUSB=y
CONFIG_TINYUSB_NET_ENABLED=y
CONFIG_TINYUSB_DESC_USE_ESPRESSIF_VID=n
CONFIG_TINYUSB_DESC_CUSTOM_VID=0x303A
CONFIG_TINYUSB_DESC_USE_DEFAULT_PID=n
CONFIG_TINYUSB_DESC_CUSTOM_PID=0x3000

# ppp config
CONFIG_LWIP_PPP_SUPPORT=y
CONFIG_LWIP_PPP_MPPE_SUPPORT=y
CONFIG_LWIP_PPP_NOTIFY_PHASE_SUPPORT=y
CONFIG_LWIP_PPP_ENABLE_IPV6=n
CONFIG_LWIP_TCPIP_TASK_STACK_SIZE=8192
CONFIG_COMPILER_CXX_EXCEPTIONS=y
CONFIG_LWIP_ENABLE_LCP_ECHO=y
CONFIG_LWIP_LCP_ECHOINTERVAL=10
CONFIG_LWIP_LCP_MAXECHOFAILS=3
```
